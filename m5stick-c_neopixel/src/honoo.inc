static const uint32_t honoo[29][120]={
{0xff2d2d,0xed1c24,0xed1c24,0xed1c24,0xed1c24,0xed1c24,0xed1c24,0xed1c24,0xed1c24,0xed1c24,0xed1c24,0xed1c24,0xed1c24,0xed1c24,0xc10f21,0xc10f21,0xc10f21,0xc10f21,0xc10f21,0xc10f21,0xc10f21,0xc10f21,0xc10f21,0xc10f21,0xff2d2d,0xc10f21,0xc10f21,0xc10f21,0xc10f21,0xc10f21,0xc10f21,0xc10f21,0xed1c24,0xed1c24,0xed1c24,0xed1c24,0xed1c24,0xed1c24,0xed1c24,0xed1c24,0xed1c24,0xed1c24,0xed1c24,0xed1c24,0xed1c24,0xed1c24,0xed1c24,0xed1c24,0xff2d2d,0xff2d2d,0xff2d2d,0xed1c24,0xed1c24,0xed1c24,0xed1c24,0xed1c24,0xed1c24,0xed1c24,0xed1c24,0xed1c24,0xed1c24,0xed1c24,0xed1c24,0xed1c24,0xed1c24,0xc10f21,0xc10f21,0xc10f21,0xc10f21,0xff0000,0xd72428,0x35090c,0x000000,0x000000,0x000000,0x000000,0x000000,0x050301,0x0f0a04,0xed1c24,0xed1c24,0xed1c24,0x000000,0xed1c24,0xed1c24,0xc10f21,0x0f0e07,0xed1c24,0xed1c24,0xed1c24,0xed1c24,0xed1c24,0x0f0c07,0xc37345,0x000000,0x000000,0x0c0203,0x130304,0x0d0302,0xae2321,0xdb2830,0xed1c24,0x581014,0x1b0506,0x000000,0x000000,0x000000,0x000000,0x000000,0x000000,0x000000,0x000000,0x000000,0x000000,0x000000,0x000000,0x000000,0x000000,0x000000,0x000000},
{0xc77a30,0xed1c24,0xed1c24,0xc10f21,0xc10f21,0xc75739,0xb82a21,0xbd0e23,0xd40a29,0xd41226,0xff2d2d,0xff2d2d,0xf04727,0xed1c24,0xed1c24,0xc10f21,0xed1c24,0xec1c24,0xc10f21,0xc10f21,0xc10f21,0xc10f21,0xc10f21,0xc10f21,0xff2d2d,0xed1c24,0xed1c24,0xff2d2d,0xff2d2d,0xd1271f,0xcd331d,0xda391f,0xc10f21,0xc10f21,0xc10f21,0xc10f21,0xea3225,0xed1c24,0xc10f21,0xc10f21,0xc10f21,0xc10f21,0xc10f21,0xc10f21,0xc10f21,0xed1c24,0xed1c24,0xed1c24,0xed1c24,0xff2d2d,0xff2d2d,0xff2d2d,0xff2d2d,0xed1c24,0xed1c24,0xed1c24,0xed1c24,0xed1c24,0xed1c24,0xed1c24,0xed1c24,0xed1c24,0xed1c24,0xed1c24,0xed1c24,0xed1c24,0xed1c24,0xff0000,0xff0000,0xc10f21,0xc10f21,0x150204,0x000000,0x000000,0x000000,0x000000,0x000000,0x000000,0xcc6c33,0x0e0703,0x35190b,0xed1c24,0xed1c24,0x000000,0xed1c24,0xed1c24,0xc10f21,0xc10f21,0x000000,0x000000,0xc10f21,0xed1c24,0x000000,0xc9b74b,0x2f2a15,0x000000,0x4e2815,0x4e150e,0x200606,0x000000,0x0d0203,0xaf1a1e,0xed1c24,0xed1c24,0xd82a22,0xde2520,0xe31e20,0xe71823,0xd91622,0x3e0a0b,0x000000,0x000000,0x000000,0x000000,0x000000,0x000000,0x000000,0x000000,0x000000,0x000000},
{0xc10f21,0xc10f21,0xc10f21,0xed1c24,0xff2d2d,0xc10f21,0xc10f21,0xc10f21,0xc7673b,0xb32827,0xc01b2d,0xff2d2d,0xff2d2d,0xff2d2d,0xed1c24,0xed1c24,0xc10f21,0xc10f21,0xc10f21,0xc10f21,0xc10f21,0xc10f21,0xc10f21,0xc10f21,0xff2d2d,0xff2d2d,0xed1c24,0xed1c24,0xff2d2d,0xff2d2d,0xdc132c,0xd7161e,0xdd172c,0xdb1532,0xd91b2d,0xd51f25,0xdc1b1d,0xdc1422,0xd9182d,0xe81f24,0xed1c24,0xed1c24,0xed1c24,0xed1c24,0xed1c24,0xc10f21,0xc10f21,0xc10f21,0xc10f21,0xc10f21,0xc10f21,0xc10f21,0xff2d2d,0xff2d2d,0xff2d2d,0xff2d2d,0xed1c24,0xed1c24,0xed1c24,0xed1c24,0xed1c24,0xed1c24,0xed1c24,0xed1c24,0xed1c24,0xed1c24,0xed1c24,0xed1c24,0xed1c24,0xff0000,0xff0000,0xc10f21,0xc10f21,0x000000,0x000000,0x000000,0x000000,0x030101,0xed1c24,0xed1c24,0xed1c24,0xed1c24,0xed1c24,0xed1c24,0x000000,0xed1c24,0xed1c24,0xed1c24,0xed1c24,0xc10f21,0xc10f21,0xc10f21,0xc10f21,0x000000,0x000000,0x2f2a14,0x000000,0x000000,0x000000,0x000000,0x000000,0x0b0202,0x8d151e,0xed1c24,0xed1c24,0xed1c24,0xdc2827,0xdb2727,0xd92629,0xca2427,0x5a0e10,0x1c0405,0x000000,0x000000,0x000000,0x000000,0x000000,0x000000,0x000000,0x000000},
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{0x000000,0x000000,0x000000,0x000000,0x000000,0x000000,0x000000,0x010101,0x000000,0x000000,0x000000,0x000000,0x000000,0x000000,0x000000,0x000000,0x000000,0x000000,0x000000,0x000000,0x000000,0x000000,0x000000,0x000000,0x000000,0x000000,0x000000,0x000000,0x000000,0x000000,0x000000,0x000000,0x000000,0x000000,0x000000,0xc10f21,0xc10f21,0x000000,0x000000,0x000000,0x000000,0x000000,0x000000,0x000000,0x000000,0x000000,0x000000,0x000000,0x000000,0x000000,0x000000,0x000000,0x000000,0x000000,0x000000,0x000000,0x000000,0x000000,0x000000,0x000000,0x000000,0x000000,0x000000,0x000000,0x000000,0x000000,0x000000,0x000000,0x000000,0x000000,0x000000,0x000000,0x000000,0x000000,0x000000,0x000000,0x000000,0x000000,0x000000,0x000000,0x000000,0x000000,0x000000,0x000000,0x000000,0x000000,0x000000,0x000000,0x000000,0x000000,0x000000,0x000000,0x000000,0x000000,0x000000,0x000000,0x000000,0x000000,0x000000,0x000000,0x000000,0x000000,0x000000,0x000000,0x000000,0x000000,0x000000,0x000000,0x000000,0x000000,0x000000,0x000000,0x000000,0x000000,0x000000,0x000000,0x000000,0x000000,0x000000,0x000000},
};
